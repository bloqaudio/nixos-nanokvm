/* Experimental SG2002 high-speed USB override.
 *
 * Keep this separate from sg2002-licheerv-nano-bw.dtsi: the shared base
 * remains capped at the proven full-speed fallback while we validate the
 * Linux handoff from U-Boot's high-speed fastboot gadget.  Concatenating
 * this file last replaces only maximum-speed, so an A/B uses the same
 * kernel, FIFO layout, DMA mode, gadget functions, cable, and host port.
 */

&usb {
	maximum-speed = "high-speed";
};
