/dts-v1/;

/ {
	#address-cells = <1>;
	#size-cells = <1>;

	test_intc: interrupt-controller {
		compatible = "test,interrupt-controller";
		interrupt-controller;
		#interrupt-cells = <2>;
	};

	soc {
		#address-cells = <1>;
		#size-cells = <1>;
		ranges;
		interrupt-parent = <&test_intc>;
	};
};

#include "sg2002-c906l-contract.dtsi"
